#include "dactyl46.dtsi"

&default_transform { // The matrix transform for this board is 6 columns over because the left half is 6 columns wide according to the matrix.
    col-offset = <6>;
};

&kscan0 {
    col-gpios
        = <&pro_micro 7 GPIO_ACTIVE_HIGH> // col6 in the schematic
        , <&pro_micro 6 GPIO_ACTIVE_HIGH> // col7 in the schematic
        , <&pro_micro 5 GPIO_ACTIVE_HIGH> // col8 in the schematic
        , <&pro_micro 4 GPIO_ACTIVE_HIGH> // col9 in the schematic
        , <&pro_micro 3 GPIO_ACTIVE_HIGH> // col10 in the schematic
        , <&pro_micro 2 GPIO_ACTIVE_HIGH> // col11 in the schematic
        ;
};
